## extras/drivers/sensor/Kconfig
```kconfig
# Copyright (c) 2021 LION
# SPDX-License-Identifier: Apache-2.0

if SENSOR
rsource "cc2d23s/Kconfig"
rsource "mics4514/Kconfig"
endif # SENSOR
```

## extras/drivers/sensor/cc2d23s/Kconfig
```kconfig
# Copyright (c) 2021 LION
# SPDX-License-Identifier: Apache-2.0

menuconfig CC2D23S
	bool "CC2D23S Temperature and Humidity Sensor"
	depends on I2C
	help
	  Enable driver for CC2D23S.

if CC2D23S

endif
```

## extras/drivers/sensor/mics4514/Kconfig
```kconfig
# Copyright (c) 2021 LION
# SPDX-License-Identifier: Apache-2.0

menuconfig MICS4514
	bool "MICS4514 MOS gas sensor"
	depends on ADC && GPIO && NEWLIB_LIBC
	help
	  Enable driver for MICS4514.
if MICS4514
config MICS4514_DEFAULT_CO_R0
	int "Default calibrated CO sensor resistance R0"
	range 0 100000
	default 41377
	help
	  The calibrated value in ohms of the stable sensor resistance
	  at 1000 ppm CO concentration.
	
config MICS4514_DEFAULT_NO2_R0
	int "Default calibrated NO2 sensor resistance R0"
	range 0 100000
	default 900
	help
	  The calibrated value in ohms of the stable sensor resistance
	  at 1000 ppm NO2 concentration.

config MICS4514_SENSOR_VREF_MV
	int "Sensor voltage reference in mv"
	range 3000 5100
	default 3300
	help
	  The voltage reference for the sensor, used to calulate sensor resistance

config MICS4514_PREHEAT_SECONDS
	int "Sensor preheat time in seconds"
	range 0 120
	default 30
	help
	  The amount of time (in seconds) to run the preheat function
endif
```

## extras/dts/bindings/sensor/amphenol,cc2d23s.yaml
```yaml
description: |
    Amphenol humidity and temperature sensor. See
    https://www.amphenol-sensors.com/en/telaire/humidity/527-humidity-sensors/3095-chipcap-2

compatible: "amphenol,cc2d23s"

include: i2c-device.yaml
```

## extras/dts/bindings/sensor/amphenol,mics4514.yaml
```yaml
description: |
    Amphenol (SGX Sensortech) MOS gas sensor. See
    https://www.sgxsensortech.com/content/uploads/2014/08/0278_Datasheet-MiCS-4514-rev-16.pdf

compatible: "amphenol,mics4514"

include: base.yaml

properties:
    io-channels:
        required: true
        description: IO channel for sensor measurement

    rload-red-ohms:
        type: int
        required: true
        description: Resistance of the load resistor for the CO sensor

    rload-ox-ohms:
        type: int
        required: true
        description: Resistance of the load resistor for the NOX sensor

    preheat-gpios:
        type: phandle-array
        required: false
        description: I/O used to control preheat function of sensor
```

## tests/drivers/sensor/cc2d23s/testcase.yaml
```yaml
tests:
  drivers.sensor.cc2d23s:
    build_only: true
    filter: dt_compat_enabled("amphenol,cc2d23s")
    integration_platforms:
      - nrf52840dk_nrf52840
```

## tests/drivers/sensor/gas/testcase.yaml
```yaml
tests:
  drivers.sensor.gas.mics4514:
    build_only: true
    platform_allow: nrf52840dk_nrf52840
    extra_args: CONF_FILE="prj.conf;overlays/mics4514.conf" DTC_OVERLAY_FILE="overlays/mics4514.overlay"
    tags: pyrrha gas mics4514
  drivers.sensor.gas.mics4514.preheat:
    build_only: true
    platform_allow: nrf52840dk_nrf52840
    extra_args: CONF_FILE="overlays/mics4514.conf" DTC_OVERLAY_FILE="overlays/mics4514_preheat.overlay"
    tags: pyrrha gas mics4514 preheat
```

## tests/drivers/sensor/rht/testcase.yaml
```yaml
tests:
  drivers.sensor.rht:
    build_only: true
    platform_allow: nrf52840dk_nrf52840
    tags: pyrrha rht
```

## west.yml
```yaml
# Copyright (c) 2021 LION
# SPDX-License-Identifier: Apache-2.0

manifest:
  self:
    path: Pyrrha-Z

  remotes:
    - name: zephyrproject-rtos
      url-base: https://github.com/zephyrproject-rtos

  projects:
    - name: zephyr
      remote: zephyrproject-rtos
      revision: zephyr-v2.6.0
      import:
        path-prefix: rtos
```
