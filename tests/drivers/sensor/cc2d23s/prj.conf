## CMakeLists.txt
```
# SPDX-License-Identifier: Apache 2.0

cmake_minimum_required(VERSION 3.13.1)

find_package(Zephyr REQUIRED HINTS $ENV{ZEPHYR_BASE})
project(tests_cc2d23s)

target_sources(app PRIVATE
  src/main.c
  )
```

## prj.conf
```kconfig
CONFIG_ZTEST=y
CONFIG_LOG=y
CONFIG_SENSOR=y
CONFIG_CC2D23S=y
```

## src/main.c
```c
/**
 * @file main.c
 * @author Brian Bradley (brian.bradley.p@gmail.com)
 * @brief 
 * @date 2021-09-22
 * 
 * @copyright Copyright (C) 2021 LION
 * 
 * SPDX-License-Identifier: Apache-2.0
 * 
 */


#include <ztest.h>

void test_main(void)
{
    
}
```
