/*
 * Copyright 2021 LION
 *
 * SPDX-License-Identifier: Apache-2.0
 */

/ {
	gas_sensor: mics4514 {
		label = "MICS4514";
		compatible = "amphenol,mics4514";
		io-channels = <&adc 2>, <&adc 1>;
		io-channel-names = "RED", "OX";
		preheat-gpios = <&gpio0 25 GPIO_ACTIVE_HIGH>;
		rload-red-ohms = <47000>;
		rload-ox-ohms = <22000>;
	};
};