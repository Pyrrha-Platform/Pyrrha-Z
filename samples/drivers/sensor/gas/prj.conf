## CMakeLists.txt
```
# SPDX-License-Identifier: Apache 2.0

cmake_minimum_required(VERSION 3.20.0)

find_package(Zephyr REQUIRED HINTS $ENV{ZEPHYR_BASE})
project(sample_gas_sensor)

target_sources(app PRIVATE
  src/main.c
  )
```

## sample.yaml
```
sample:
  name: Gas Sensor Sample
  description: Demonstrate basic usage of gas sensor
common:
  tags: pyrrha sensor gas
tests:
  sample.sensor.mics4514:
    build_only: true
    platform_allow: nrf52840dk_nrf52840
    extra_args: CONF_FILE="prj.conf;overlays/mics4514.conf" DTC_OVERLAY_FILE="overlays/mics4514.overlay"
    tags: mics4514
  sample.sensor.mics4514.preheat:
    build_only: true
    platform_allow: nrf52840dk_nrf52840
    extra_args: CONF_FILE="prj.conf;overlays/mics4514.conf" DTC_OVERLAY_FILE="overlays/mics4514_preheat.overlay"
    tags: mics4514 preheat
```

## prj.conf
```kconfig
CONFIG_SENSOR=y
CONFIG_LOG=y
CONFIG_SENSOR_LOG_LEVEL_DBG=y
```

## src/main.c
```c
/**
 * @file main.c
 * @author Brian Bradley (brian.bradley.p@gmail.com)
 * @brief Sample usage for gas sensor
 * @date 2021-10-06
 * 
 * @copyright Copyright (C) 2021 LION
 * 
 * SPDX-License-Identifier: Apache-2.0
 * 
 */
#include <zephyr.h>
#include <drivers/sensor.h>
#include <drivers/sensor/mics4514.h>

#define GAS_SENSOR	DT_LABEL(DT_NODELABEL(gas_sensor))

void main(void)
{
	const struct device *gas;
	int ret;

	gas = device_get_binding(GAS_SENSOR);
	if (gas == NULL) {
		printk("Error getting gas sensor device: %s\n", GAS_SENSOR);
	}

	while (1) {
		struct sensor_value co = {0};
		struct sensor_value no2 = {0};

		if (gas != NULL){
			if ((ret = sensor_sample_fetch(gas)) != 0){
				printk("gas sensor fetch error: %d\n", ret);
			}
			else{
				sensor_channel_get(gas, SENSOR_CHAN_MICS4514_CO,
					&co);
				sensor_channel_get(gas, SENSOR_CHAN_MICS4514_NO2,
					&no2);
			}
		}
		printk("CO(ppm)=%d.%d, NO2(ppm)=%d.%d\n", co.val1, co.val2, no2.val1, no2.val2);
		k_msleep(1000);
	}
}
```
